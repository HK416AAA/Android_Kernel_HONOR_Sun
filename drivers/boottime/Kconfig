## drivers/boottime/Kconfig
```kconfig
config HONOR_BOOT_TIME
	tristate "Boot Time Recoder"
	default n
	help
	  A driver to record boot time.
```

## fs/wb_pin/Kconfig
```kconfig
config WB_PIN_MODE
	tristate "fs pin mode set"
	default n
config WB_PIN_FILE
	tristate "file pin set"
	default n
```

## init/Kconfig.gki-debug
```kconfig
config GKI_HIDDEN_RCUTORTURE
	bool
	select TASKS_RUDE_RCU

config GKI_HACKS_FOR_DEBUG_CONFIG
	bool "GKI Dummy config options for debug configurations"
	select TRACE_PREEMPT_TOGGLE
	select TRACE_IRQFLAGS
	select GKI_HIDDEN_RCUTORTURE

config HONOR_DEBUG
	bool "Enables Honor debug macro"
	default n
	help
	  This enables the CONFIG_HONOR_DEBUG macro, instead of
	  CONFIG_FINAL_RELEASE. Since we could not change gki_defconfig,
	  CONFIG_FINAL_RELEASE could not be enabled on GKI build, which
	  definitely should be a final-release build.

	  CONFIG_HONOR_DEBUG indicates non-final-release build.

config HONOR_RPHONE_DEBUG
	tristate "Use honor rphone code"
	default n
	help
	  use honor rphone code
```

## mm/mem_stats/Kconfig
```kconfig
config HONOR_MEM_STATS
	bool "Enable mem stats"
	default n

config HONOR_MEM_REPORT
	bool "Enable mem report"
	depends on HONOR_MEM_STATS
	default n

config HONOR_CMA_REPORT
	bool "CMA alloc timeout or fail report event"
	depends on HONOR_MEM_REPORT
	default n

config HONOR_DMA_BUF_REPORT
	bool "DMA-BUF alloc timeout or fail report event"
	depends on HONOR_MEM_REPORT
	default n

config HONOR_GPU_MEM_REPORT
	bool "GPU alloc timeout or fail report event"
	depends on HONOR_MEM_REPORT
	default n

config HONOR_KMALLOC_REPORT
	bool "KMALLOC alloc fail report event"
	depends on HONOR_MEM_REPORT
	default n

config HONOR_BUDDY_INFO_REPORT
	bool "Enable buddy info event report"
	depends on HONOR_MEM_REPORT
	default n

config HONOR_MEM_DETECT
	bool "if free page、file page、anon page anomal, event report"
	depends on HONOR_MEM_STATS
	default n

config HONOR_ISOLATED_DETECT
	bool "if isolated anomal, event report"
	depends on HONOR_MEM_DETECT
	default n

config HONOR_PAGE_FAULT_STATS
	bool "alloc pages statistics when page fault"
	depends on HONOR_ALLOC_STATS
	default n

config HONOR_ANON_PAGE_STAT
	bool "alloc anonymous pages statistics when page fault"
	depends on HONOR_PAGE_FAULT_STATS
	default n

config HONOR_FILE_PAGE_STAT
	bool "alloc file pages statistics when page fault"
	depends on HONOR_PAGE_FAULT_STATS
	default n

config HONOR_SWAP_PAGE_STAT
	bool "alloc swap pages statistics when page fault"
	depends on HONOR_PAGE_FAULT_STATS
	default n

config MEM_CGROUP_ALLOC_STAT
	bool "alloc pages statistics for mem cgroup"
	depends on HONOR_ALLOC_STATS
	default n

source "mm/mem_stats/memlock_stats/Kconfig"
source "mm/mem_stats/page_lock/Kconfig"
```

## mm/mem_stats/page_lock/Kconfig
```kconfig
config DEBUG_PAGE_LOCK
	bool "Debug page locking"
	depends on DEBUG_KERNEL
	select PAGE_EXTENSION
	select DEBUG_FS
	default n
	help
	  This keeps track of what call chain is the owner of a lock page.
	  If unsure, say N.
```
